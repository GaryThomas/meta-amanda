## conf/layer.conf
```bitbake
# We have a conf and classes directory, add to BBPATH
BBPATH := "${LAYERDIR}:${BBPATH}"

# We have a packages directory, add to BBFILES
BBFILES := "${BBFILES} \
            ${LAYERDIR}/recipes*/*/*.bb \
  	    ${LAYERDIR}/recipes*/*/*.bbappend"

BBFILE_COLLECTIONS += "amanda"
BBFILE_PATTERN_amanda := "^${LAYERDIR}/"
BBFILE_PRIORITY_amanda = "7"

# Extra/non-standard licenses used within this layer
LICENSE_PATH_append = " ${LAYERDIR}/licenses"
```
